## configs/cf2p_defconfig
```kconfig
CONFIG_PLATFORM_CF2=y
CONFIG_THRUST_BAT_COMPENSATION_TYPE=1

CONFIG_MODIFY_CF_MASS=y
CONFIG_MODIFIED_CF_MASS=34000
```

## configs/cf2t_defconfig
```kconfig
CONFIG_PLATFORM_CF2=y
CONFIG_THRUST_BAT_COMPENSATION_TYPE=2

CONFIG_MODIFY_CF_MASS=y
CONFIG_MODIFIED_CF_MASS=34700
```

## configs/magnetdeck_defconfig
```kconfig
CONFIG_PLATFORM_CF2=y
CONFIG_THRUST_BAT_COMPENSATION_TYPE=1

CONFIG_DECK_FORCE="magnet"
CONFIG_DECK_MAGNET=y
```

## configs/meloncopter_defconfig
```kconfig
CONFIG_PLATFORM_BICOPTER=y

CONFIG_BICOPTER_NAME_MELONCOPTER=y
# CONFIG_PROPELLER_WINDANCER is not set
CONFIG_PROPELLER_HURRICANE=y
# CONFIG_BATTERY_550 is not set
CONFIG_BATTERY_1550=y

CONFIG_CONTROLLER_LQR=y
CONFIG_ESTIMATOR_KALMAN_ENABLE=y
CONFIG_ESTIMATOR_OUTLIER_FILTERS=y
CONFIG_ESTIMATOR_KALMAN=y

CONFIG_MOTORS_REQUIRE_ARMING=y

CONFIG_MOTORS_ESC_PROTOCOL_DSHOT=y
CONFIG_MOTORS_DSHOT_PWM_300KHZ=y

CONFIG_DECK_BICOPTER=y
CONFIG_DECK_FORCE="bicopterDeck"

CONFIG_ENABLE_THRUST_BAT_COMPENSATED=n
```
